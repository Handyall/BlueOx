## board/freescale/mx6blueox/Kconfig
```kconfig
if TARGET_MX6BLUEOX

config SYS_BOARD
	default "mx6blueox"

config SYS_VENDOR
	default "freescale"

config SYS_CONFIG_NAME
	default "mx6blueox"

endif
```
